## buildroot-external/Config.in
```kconfig
source "$BR2_EXTERNAL_LVA_OS_PATH/package/gasket/Config.in"
source "$BR2_EXTERNAL_LVA_OS_PATH/package/hailo8-firmware/Config.in"
source "$BR2_EXTERNAL_LVA_OS_PATH/package/hailo-pci/Config.in"
source "$BR2_EXTERNAL_LVA_OS_PATH/package/lva-supervisor/Config.in"
source "$BR2_EXTERNAL_LVA_OS_PATH/package/pi-bluetooth/Config.in"
source "$BR2_EXTERNAL_LVA_OS_PATH/package/rpi-eeprom/Config.in"
source "$BR2_EXTERNAL_LVA_OS_PATH/package/rtl88x2bu/Config.in"
source "$BR2_EXTERNAL_LVA_OS_PATH/package/tempio/Config.in.host"
source "$BR2_EXTERNAL_LVA_OS_PATH/package/udisks2/Config.in"
```

## buildroot-external/package/lva-supervisor/Config.in
```kconfig
config BR2_PACKAGE_LVA_SUPERVISOR
	bool "LVA Supervisor"
	help
	  LVA-OS supervisor service.
	  https://github.com/aryanhasgithub/lva-supervisor

config BR2_PACKAGE_LVA_OS_MACHINE
	string "LVA-OS Machine"
	depends on BR2_PACKAGE_LVA_SUPERVISOR
	help
	  Machine identifier used for RAUC OTA bundle selection
	  and supervisor container routing.
```
